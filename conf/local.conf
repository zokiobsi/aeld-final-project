## conf/local.conf
```bitbake
MACHINE = "qemuarm64"
DL_DIR ?= "${TOPDIR}/../downloads"
SSTATE_DIR ?= "${TOPDIR}/../sstate-cache"
DISTRO_FEATURES:append = " wifi"
IMAGE_INSTALL:append = " wireless-regdb-static wpa-supplicant"
WIRELESS_REGDOM = "US"
```
